## CMakeLists.txt
```
cmake_minimum_required(VERSION 3.20.0)

find_package(Zephyr REQUIRED HINTS $ENV{ZEPHYR_BASE})
project(uart)

target_sources(app PRIVATE
    src/main.cpp
    ../common/uart.cpp
    ../common/frames.cpp
    ../common/sensors.cpp
    ../common/PLATFORM_HAL.cpp)

target_include_directories(app PRIVATE
    ${CMAKE_CURRENT_SOURCE_DIR}/../common
)
```

## prj.conf
```kconfig
CONFIG_SERIAL=y
CONFIG_UART_INTERRUPT_DRIVEN=y

CONFIG_GPIO=y
CONFIG_SDMMC_STM32=y
```

## boards/arm/stm32f746g_disco.overlay
```dts
&usart6 {
        current-speed = <9600>;
};

&sdmmc1 {
        status = "okay";
	bus-width = <4>;
};
```

## src/main.cpp
```c
#include <zephyr/kernel.h>
#include <zephyr/device.h>
#include <zephyr/drivers/uart.h>

#include "uart.h"
#include "frames.h"


//uint8_t buffer[MAX_BUFFER] = {0,1,2,3,4,5};

//K_THREAD_DEFINE(ping_thread, 1024, pinging, NULL, NULL, NULL,
//                5, 0, 0);
//K_THREAD_DEFINE(uart_listen_thread, 1024, uart_listen, NULL, NULL, NULL,
//                6, 0, 0);

int main()
{
    //send boot message


    k_msleep(250);
    uart_init();

    //printf("hij pingt\n");
    k_msleep(666);
    //printf("en het programma gaat ongestoord verder\n");

    // SEND BOOT MESSAGE
    BootFrame Boot(NULL, MAX_BUFFER);
    Boot.structToBitstream(tx_buffer);

    return 0;
}
```
